## config/boards/arm/bw2/Kconfig.defconfig
```kconfig
# Copyright (c) 2020 The ZMK Contributors
# SPDX-License-Identifier: MIT

if BOARD_BW2

config BOARD
    default "bw2"

config ZMK_KEYBOARD_NAME
    default "Bad Wings v2"

config ZMK_USB
    default y

config ZMK_KSCAN_MATRIX_POLLING
    default y

endif 
```

## config/boards/shields/sweep/Kconfig.defconfig
```kconfig
# Copyright (c) 2022 The ZMK Contributors
# SPDX-License-Identifier: MIT

if SHIELD_SWEEP_LEFT

config ZMK_KEYBOARD_NAME
    default "sweep"

config ZMK_SPLIT_ROLE_CENTRAL
    default y

endif

if SHIELD_SWEEP_LEFT || SHIELD_SWEEP_RIGHT
config ZMK_SPLIT
    default y
endif
```

## config/boards/shields/sweep/Kconfig.shield
```kconfig
# Copyright (c) 2022 The ZMK Contributors
# SPDX-License-Identifier: MIT

config SHIELD_SWEEP_LEFT
    def_bool $(shields_list_contains,sweep_left)

config SHIELD_SWEEP_RIGHT
    def_bool $(shields_list_contains,sweep_right)
```
