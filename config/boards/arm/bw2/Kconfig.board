## config/boards/arm/bw2/Kconfig.board
```kconfig
# Copyright (c) 2023 The ZMK Contributors
# SPDX-License-Identifier: MIT

config BOARD_BW2
    bool "BW2"
    depends on SOC_STM32F072XB
```

## config/boards/shields/naked48/Kconfig.defconfig
```kconfig
# Copyright (c) 2020 The ZMK Contributors
# SPDX-License-Identifier: MIT

if SHIELD_NAKED48

config ZMK_KEYBOARD_NAME
    default "Naked48"

endif
```

## config/boards/shields/naked48/Kconfig.shield
```kconfig
# Copyright (c) 2020 The ZMK Contributors
# SPDX-License-Identifier: MIT

config SHIELD_NAKED48
    def_bool $(shields_list_contains,naked48)
```

## config/west.yml
```yaml
manifest:
  remotes:
    - name: zmkfirmware
      url-base: https://github.com/zmkfirmware
    - name: caksoylar
      url-base: https://github.com/caksoylar
    - name: urob
      url-base: https://github.com/urob
    - name: ssbb
      url-base: https://github.com/ssbb
  projects:
    - name: zmk
#      remote: zmkfirmware
#      revision: v0.3

#      remote: caksoylar
#      revision: caksoylar/zen-v1+v2

      remote: urob # zmkfirmware or urob
      revision: main # main or v0.2+fix-child-nodes

      import: app/west.yml

    - name: zmk-adaptive-key
      remote: urob
      revision: main # set to same as ZMK version above
    - name: zmk-auto-layer # used in &num_word
      remote: urob
      revision: main # set to same as ZMK version above
#    - name: zmk-antecedent-morph
#      remote: ssbb
#      revision: v1
  self:
    path: config
```
